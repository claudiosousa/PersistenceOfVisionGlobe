#include <SPI.h>
#include "RF24.h"
  #include <Servo.h>

RF24 radio(9, 10);

byte addresses[][6] = {
  "BoxPc", "PcBox"};

byte imageArray[] = 
{0,0,0,0,0,0,0,0,0,0,0,0,0,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3,3}
;

void setup() {
Servo firstESC;
  firstESC.attach(6);
  firstESC.writeMicroseconds(0);
  delay(2000);
  firstESC.writeMicroseconds(700);
    delay(2000);
  firstESC.writeMicroseconds(900);


  Serial.begin(57600);
  randomSeed(analogRead(0));
  radio.begin();

  radio.setPALevel(RF24_PA_MAX);

  radio.openWritingPipe(addresses[1]);
  radio.openReadingPipe(1, addresses[0]);
}

typedef struct RF24Message
{
  byte action;
  unsigned int length;
} 
RF24Message;

RF24Message message;
const byte messageSize = sizeof(message);
const byte cycles = 90;

const byte bufferSize = 32;
byte buffer[bufferSize];

void sendImage(){
  radio.stopListening();    

  message.length = cycles * bufferSize;
  message.action = 168;
  while(!radio.write(&message, messageSize)){
    delay(20);
  }
  radio.txStandBy();
  
  for (int p= 0; p<2; p++) {
    byte* image = imageArray;
    for(int c=0; c<cycles/2; c++){  
      memcpy(&buffer, image, bufferSize);
      image += bufferSize;  
      while(!radio.writeFast(&buffer, bufferSize)){       
        Serial.println("Fail: " + String(c));
        delay(20);      
      }
      radio.txStandBy();
    }
  }
  Serial.println("Sended");
}

void sendRandomImage(){
  radio.stopListening();    

  message.length = cycles * bufferSize;
  message.action = 168;
  while(!radio.write(&message, messageSize)){
    delay(20);
  }
  radio.txStandBy();

  for(int c=0; c<cycles; c++){   
    for (byte i=0; i<bufferSize; i++){
      buffer[i] = 255;//;(byte)random(256);
    } 

    while(!radio.writeFast(&buffer, bufferSize)){       
      Serial.println("Fail: " + String(c));
      delay(20);      
    }
    radio.txStandBy();
  }

  Serial.println("Sended");
}

void loop() {
  if (!Serial.available())
    return;
    
  String received = Serial.readString();

  Serial.println("Received: "+received);
  if (received == "i")
    sendImage();
  else
    sendRandomImage();
  /*
  //
   char *msg = (char *)&message;
   Serial.readBytes(msg, 3);
   Serial.println(message.action);
   Serial.println(message.messageLength);
   */
} 







